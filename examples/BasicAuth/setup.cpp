

/*
 * setup.cpp -- part of the BasicAuth project.
 * Setup of SerialUI and menu system
 * Pat Deegan
 * Psychogenic.com 
 * 
 * Copyright (C) 2019 Pat Deegan, psychogenic.com
 * 
 * Generated by DruidBuilder [https://devicedruid.com/], 
 * as part of project "f479e26ae09b4eab8cb47b1383145f81zGgk4QUJUp",
 * aka BasicAuth.
 * 
 * Druid4Arduino, Device Druid, Druid Builder, the builder 
 * code brewery and its wizards, SerialUI and supporting 
 * libraries, as well as the generated parts of this program 
 * are 
 *            Copyright (C) 2013-2018 Pat Deegan 
 * [https://psychogenic.com/ | https://inductive-kickback.com/]
 * and distributed under the terms of their respective licenses.
 * See https://devicedruid.com for details.
 * 
 * 
 * This program is distributed in the hope that it will be useful,
 * but WITHOUT ANY WARRANTY; without even the implied warranty of
 * MERCHANTABILITY or FITNESS FOR A PARTICULAR PURPOSE. 
 * THE ENTIRE RISK AS TO THE QUALITY AND PERFORMANCE OF THE 
 * PROGRAM IS WITH YOU. SHOULD THE PROGRAM PROVE DEFECTIVE, 
 * YOU ASSUME THE COST OF ALL NECESSARY SERVICING, REPAIR OR
 * CORRECTION.
 * 
 * Keep in mind that there is no warranty and you are solely 
 * responsible for the use of all these cool tools.
 * 
 * Play safe, have fun.
 * 
 */


/* we need the SerialUI lib */
#include <SerialUI.h>
#include "BasicAuthSettings.h"

/* our project specific types and functions are here */
#include "BasicAuth.h"



/* MySUI
 * Our SerialUI Instance, through which we can send/receive
 * data from users. Actually instantiated here, for global use.
 */
SUI::SerialUI MySUI(7);


/*
 * The container for MyInputs, which
 * holds all the variables for the various inputs.
 * Actually instantiated here, for global use.
 */
MyInputsContainerSt MyInputs;










bool SetupSerialUI() {

  MySUI.setName("AuthTest"); // only useful on BLE projects
  
	MySUI.setGreeting(F(serial_ui_greeting_str));
	// SerialUI acts just like (is actually a facade for)
	// Serial.  Use _it_, rather than Serial, throughout the
	// program.
	// basic setup of SerialUI:
	MySUI.begin(serial_baud_rate); // serial line open/setup
	// MySUI.setTimeout(serial_readtimeout_ms);   // timeout for reads (in ms), same as for Serial.
	MySUI.setMaxIdleMs(serial_maxidle_ms);    // timeout for user (in ms)
	// how we are marking the "end-of-line" (\n, by default):
	MySUI.setReadTerminator(serial_input_terminator);
	// project UID -- will be used to remember state in Druid...
	MySUI.setUID(SUI_STR("f479e26ae09b4eab8cb47b1383145f81zGgk4QUJUp"));

	
	
	
	
	
	// a few error messages we hopefully won't need
	
	SUI_FLASHSTRING CouldntCreateMenuErr = F("Could not create menu?");
	SUI_FLASHSTRING CouldntAddItemErr = F("Could not add item?");
	
	// get top level menu, to start adding items
	SerialUI::Menu::Menu * topMenu = MySUI.topLevelMenu();
	if (! topMenu ) {
		// well, that can't be good...
		MySUI.returnError(F("Very badness in sEriALui!1"));
		return false;
	}
	
	
	
	/* *** Main Menu *** */


	SerialUI::Menu::Menu * submen1 = topMenu->subMenu(
		SUI_STR("sub menu"),
		SUI_STR("a sub menu to enter"));
	if (! submen1 ) { 
		DIE_HORRIBLY(CouldntCreateMenuErr);
	}


	
	if( ! topMenu->addCommand(
		SUI_STR("click me"),
		MainMenu::doClickMe,
		SUI_STR("a command to run"))) {
		MySUI.returnError(CouldntAddItemErr);
		return false;
	}
	

	
	if( ! topMenu->addText(
		SUI_STR("Some Inputs"),
		SUI_STR("A few inputs to fill"))) {
		MySUI.returnError(CouldntAddItemErr);
		return false;
	}
	

	
	if( ! topMenu->addRequest(
		MyInputs.YesOrNo)) {
		MySUI.returnError(CouldntAddItemErr);
		return false;
	}
	

	
	if( ! topMenu->addRequest(
		MyInputs.LimitedChoice)) {
		MySUI.returnError(CouldntAddItemErr);
		return false;
	}
	

	
	if( ! topMenu->addRequest(
		MyInputs.Name)) {
		MySUI.returnError(CouldntAddItemErr);
		return false;
	}
	

	
	if( ! topMenu->addRequest(
		MyInputs.Options)) {
		MySUI.returnError(CouldntAddItemErr);
		return false;
	}
	



	/* *** Main Menu -> sub menu *** */

	
	if( ! submen1->addRequest(
		MyInputs.When)) {
		MySUI.returnError(CouldntAddItemErr);
		return false;
	}
	

	
	if( ! submen1->addCommand(
		SUI_STR("another command"),
		MainMenu::SubMenu::doAnotherCommand,
		SUI_STR("click this if you like"))) {
		MySUI.returnError(CouldntAddItemErr);
		return false;
	}
	


	
	
	
	return true;
	
}
