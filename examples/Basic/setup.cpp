

/*
   setup.cpp -- part of the Basic project.
   Setup of SerialUI and menu system
   Pat Deegan
   Psychogenic http://devicedruid.com

   Copyright (C) 2017 Pat Deegan

   Generated by DruidBuilder [https://devicedruid.com/],
   as part of project "a0883ee49bc54e8cbaab40d0f94ce1756TXZKE4vNm",
   aka Basic.

   Druid4Arduino, Device Druid, Druid Builder, the builder
   code brewery and its wizards, SerialUI and supporting
   libraries, as well as the generated parts of this program
   are
              Copyright (C) 2013-2017 Pat Deegan
   [http://psychogenic.com/ | http://flyingcarsandstuff.com/]
   and distributed under the terms of their respective licenses.
   See http://devicedruid.com for details.


   This program is distributed in the hope that it will be useful,
   but WITHOUT ANY WARRANTY; without even the implied warranty of
   MERCHANTABILITY or FITNESS FOR A PARTICULAR PURPOSE.
   THE ENTIRE RISK AS TO THE QUALITY AND PERFORMANCE OF THE
   PROGRAM IS WITH YOU. SHOULD THE PROGRAM PROVE DEFECTIVE,
   YOU ASSUME THE COST OF ALL NECESSARY SERVICING, REPAIR OR
   CORRECTION.

   Keep in mind that there is no warranty and you are solely
   responsible for the use of all these cool tools.

   Play safe, have fun.

*/


/* we need the SerialUI lib */
#include <SerialUI.h>
#include "BasicSettings.h"

/* our project specific types and functions are here */
#include "Basic.h"



/* MySUI
   Our SerialUI Instance, through which we can send/receive
   data from users. Actually instantiated here, for global use.

   The "3" parameter, here, is a hint to SUI about how many items
   are in that top level menu.  It's here because this code was
   generated by Builder--if you're hand-coding, you might want to
   omit it and just declare

   SUI::SerialUI MySUI;


*/
SUI::SerialUI MySUI(3);


/*
   The container for MyInputs, which
   holds all the variables for the various inputs.
   Actually instantiated here, for global use.
*/
MyInputsContainerSt MyInputs;


/* MyTracked
   A structure to hold the tracked variables, which will
   automatically update the druid UI when modified by this
   program.
   Actually instantiated here, for global use.
*/
MyTrackedVarsContainerSt MyTracked;






bool SetupSerialUI() {

  MySUI.setGreeting(F(serial_ui_greeting_str));
  // SerialUI acts just like (is actually a facade for)
  // Serial.  Use _it_, rather than Serial, throughout the
  // program.
  // basic setup of SerialUI:
  MySUI.begin(serial_baud_rate); // serial line open/setup
  MySUI.setTimeout(serial_readtimeout_ms);   // timeout for reads (in ms), same as for Serial.
  MySUI.setMaxIdleMs(serial_maxidle_ms);    // timeout for user (in ms)
  // how we are marking the "end-of-line" (\n, by default):
  MySUI.setReadTerminator(serial_input_terminator);




  // Add variable state tracking

  MySUI.trackState(
    SUI_STR("ClickCount"),
    &(MyTracked.ClickCount));



  // a few error messages we hopefully won't need

  SUI_FLASHSTRING CouldntCreateMenuErr = F("Could not create menu?");
  SUI_FLASHSTRING CouldntAddItemErr = F("Could not add item?");

  // get top level menu, to start adding items
  SUI::Menu * topMenu = MySUI.topLevelMenu();
  if (! topMenu ) {
    // well, that can't be good...
    MySUI.returnError(F("Very badness in sEriALui!1"));
    return false;
  }



  /* *** Main *** */


  if ( ! topMenu->addCommand(
         SUI_STR("details"),
         Main::doDetails,
         SUI_STR("Program deets"))) {
    MySUI.returnError(CouldntAddItemErr);
    return false;
  }

  if ( ! topMenu->addCommand(
         SUI_STR("Increment Clicks"),
         Main::doIncrementClicks,
         SUI_STR("increment the click counter"))) {
    MySUI.returnError(CouldntAddItemErr);
    return false;
  }
  SUI::Menu * submen1 = topMenu->subMenu(
                          SUI_STR("Manage"),
                          SUI_STR("Manage the counter"), 
			  2);
  if (! submen1 ) {
    DIE_HORRIBLY(CouldntCreateMenuErr);
  }



  /* *** Main -> Manage *** */


  if ( ! submen1->addCommand(
         SUI_STR("reset"),
         Main::Manage::doReset,
         SUI_STR("set the counter to 0"))) {
    MySUI.returnError(CouldntAddItemErr);
    return false;
  }

  if ( ! submen1->addRequest(
         &(MyInputs.Custom),
         SUI_STR("custom"),
         SUI_STR("set the counter to a value"),
         Main::Manage::CustomIsOk,
         Main::Manage::CustomChanged)) {
    MySUI.returnError(CouldntAddItemErr);
    return false;
  }




  return true;

}


