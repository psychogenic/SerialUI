

/*
 * setup.cpp -- part of the AllWidgets project.
 * Setup of SerialUI and menu system
 * Pat Deegan
 * Psychogenic.com 
 * 
 * Copyright (C) 2019 Pat Deegan
 * 
 * Generated by DruidBuilder [https://devicedruid.com/], 
 * as part of project "b4cf0e8f5cb24a839ec218119f68cfc0lEUPnNbYtz",
 * aka AllWidgets.
 * 
 * Druid4Arduino, Device Druid, Druid Builder, the builder 
 * code brewery and its wizards, SerialUI and supporting 
 * libraries, as well as the generated parts of this program 
 * are 
 *            Copyright (C) 2013-2019 Pat Deegan 
 * [https://psychogenic.com/ | https://inductive-kickback.com/]
 * and distributed under the terms of their respective licenses.
 * See https://devicedruid.com for details.
 * 
 * 
 * This program is distributed in the hope that it will be useful,
 * but WITHOUT ANY WARRANTY; without even the implied warranty of
 * MERCHANTABILITY or FITNESS FOR A PARTICULAR PURPOSE. 
 * THE ENTIRE RISK AS TO THE QUALITY AND PERFORMANCE OF THE 
 * PROGRAM IS WITH YOU. SHOULD THE PROGRAM PROVE DEFECTIVE, 
 * YOU ASSUME THE COST OF ALL NECESSARY SERVICING, REPAIR OR
 * CORRECTION.
 * 
 * Keep in mind that there is no warranty and you are solely 
 * responsible for the use of all these cool tools.
 * 
 * Play safe, have fun.
 * 
 */


/* we need the SerialUI lib */
#include <SerialUI.h>
#include "AllWidgetsSettings.h"

/* our project specific types and functions are here */
#include "AllWidgets.h"



/* MySUI
 * Our SerialUI Instance, through which we can send/receive
 * data from users. Actually instantiated here, for global use.
 */
SUI::SerialUI MySUI(30);


/*
 * The container for MyInputs, which
 * holds all the variables for the various inputs.
 * Actually instantiated here, for global use.
 */
MyInputsContainerSt MyInputs;


/* MyTracked
 * A structure to hold the tracked variables, which will 
 * automatically update the druid UI when modified by this 
 * program.
 * Actually instantiated here, for global use.
 */
MyTrackedVarsContainerSt MyTracked;



/* MyViews
 * The container for tracking variable views.
 * It's mostly only declared statically so we 
 * can reserve memory up-front, to keep fragmentation
 * low and so tell how much memory we're eating up...
 */
MyTrackedViewsContainerSt MyViews;


MyListcycle ListCycleItems[8];
MySimpleList SimpleListItems[5];

void stuck() {
  for (;;) {
    MySUI.println("hohohoho");
    delay(1000);
  }
}

bool SetupSerialUI() {

  
  MySUI.setName("AllWidgets"); // only useful on BLE projects
  
	MySUI.setGreeting(F(serial_ui_greeting_str));
	// SerialUI acts just like (is actually a facade for)
	// Serial.  Use _it_, rather than Serial, throughout the
	// program.
	// basic setup of SerialUI:
	MySUI.begin(serial_baud_rate); // serial line open/setup
	// MySUI.setTimeout(serial_readtimeout_ms);   // timeout for reads (in ms), same as for Serial.
	MySUI.setMaxIdleMs(serial_maxidle_ms);    // timeout for user (in ms)
	// how we are marking the "end-of-line" (\n, by default):
	MySUI.setReadTerminator(serial_input_terminator);
	// project UID -- will be used to remember state in Druid...
	MySUI.setUID(SUI_STR("b4cf0e8f5cb24a839ec218119f68cfc0lEUPnNbYtz"));

  
  // stuck();
	// have a "heartbeat" function to hook-up
	MySUI.setUserPresenceHeartbeat(CustomHeartbeatCode); 
	// heartbeat_function_period_ms set in main settings header
	MySUI.setUserPresenceHeartbeatPeriod(heartbeat_function_period_ms);
	
	
	// Add variable state tracking 
	
	MySUI.trackState(MyTracked.Lights);
	
	MySUI.trackState(MyTracked.Integer);
	
	MySUI.trackState(MyTracked.Decimal);
	
	MySUI.trackState(MyTracked.Members);
	
	MySUI.trackState(MyTracked.ChatLog);
	
	MySUI.trackState(MyTracked.Heat);
	
	
	
	// Associate tracked vars with views
	MyViews.Current.associate(MyTracked.Lights);
	MyViews.Current.associate(MyTracked.Members);
	MyViews.Current.associate(MyTracked.ChatLog);
	MyViews.Current.associate(MyTracked.Heat);
	MyViews.Graph.associate(MyTracked.Integer);
	MyViews.Graph.associate(MyTracked.Decimal);
	MyViews.Portions.associate(MyTracked.Integer);
	MyViews.Portions.associate(MyTracked.Decimal);
	MyViews.Portions.associate(MyTracked.Members);
	MyViews.TheLog.associate(MyTracked.Lights);
	MyViews.TheLog.associate(MyTracked.Members);
	MyViews.TheLog.associate(MyTracked.Heat);

	
	
	// a few error messages we hopefully won't need
	
	SUI_FLASHSTRING CouldntCreateMenuErr = F("Could not create menu?");
	SUI_FLASHSTRING CouldntAddItemErr = F("Could not add item?");
	
	// get top level menu, to start adding items
	SerialUI::Menu::Menu * topMenu = MySUI.topLevelMenu();
	if (! topMenu ) {
		// well, that can't be good...
		MySUI.returnError(F("Very badness in sEriALui!1"));
		return false;
	}
	
	
	
	/* *** Main Menu *** */

  
	SerialUI::Menu::Menu * submen1 = topMenu->subMenu(
		SUI_STR("Menu 1"),
		SUI_STR("a menu"));
	if (! submen1 ) { 
		DIE_HORRIBLY(CouldntCreateMenuErr);
	}



	SerialUI::Menu::Menu * submen2 = topMenu->subMenu(
		SUI_STR("Menu 2"),
		SUI_STR("another menu"));
	if (! submen2 ) { 
		DIE_HORRIBLY(CouldntCreateMenuErr);
	}



	SerialUI::Menu::Menu * submen3 = topMenu->subMenu(
		SUI_STR("Menu 3"),
		SUI_STR("final menu"));
	if (! submen3 ) { 
		DIE_HORRIBLY(CouldntCreateMenuErr);
	}

 

	
	if( ! topMenu->addText(
		SUI_STR("Commands"),
		SUI_STR("some command buttons"))) {
		MySUI.returnError(CouldntAddItemErr);
		return false;
	}

  
  // stuck();
	
	if( ! topMenu->addCommand(
		SUI_STR("Run me"),
		MainMenu::doRunMe,
		SUI_STR("a command to run"))) {
		MySUI.returnError(CouldntAddItemErr);
		return false;
	}
	

	
	if( ! topMenu->addCommand(
		SUI_STR("Another Command"),
		MainMenu::doAnotherCommand,
		SUI_STR("click me for fun"))) {
		MySUI.returnError(CouldntAddItemErr);
		return false;
	}
  
  if( ! topMenu->addText(
    SUI_STR("Lists"),
    SUI_STR("a few lists..."))) {
    MySUI.returnError(CouldntAddItemErr);
    return false;
  }
  
  SerialUI::Menu::Menu * list1 = topMenu->addList(
    SUI_STR("List of groups"),
    SUI_STR("a repeated set of groups"));
    if (! list1 ) { 
      DIE_HORRIBLY(CouldntCreateMenuErr);
    }

    // stuck();
  
  for (uint8_t i=0; i<8; i++) {
    SerialUI::Menu::Menu * grp = list1->addGroup(
      SUI_STR("Device"),
      SUI_STR("Device settings"));
    if (! grp ) { 
      DIE_HORRIBLY(CouldntCreateMenuErr);
    }
    grp->addRequest(ListCycleItems[i].OnOrOff);

    grp->addRequest(ListCycleItems[i].SomeText);

    grp->addRequest(ListCycleItems[i].ListCol);
    
    grp->addRequest(ListCycleItems[i].SomeNumber);
  }

  SerialUI::Menu::Menu * list2 = topMenu->addList(
    SUI_STR("Simple list"),
    SUI_STR("a repeated set of single item"));
    if (! list2 ) { 
      DIE_HORRIBLY(CouldntCreateMenuErr);
    }
  
  for (uint8_t i=0; i<5; i++) {
    list2->addRequest(SimpleListItems[i].Col);
  }
	
   //  stuck();
	if( ! topMenu->addText(
		SUI_STR("Inputs"),
		SUI_STR("User input fields"))) {
		MySUI.returnError(CouldntAddItemErr);
		return false;
	}
	

	
	if( ! topMenu->addRequest(
		MyInputs.OnOrOff)) {
		MySUI.returnError(CouldntAddItemErr);
		return false;
	}
	

	
	if( ! topMenu->addRequest(
		MyInputs.HowMuch)) {
		MySUI.returnError(CouldntAddItemErr);
		return false;
	}
	

	
	if( ! topMenu->addRequest(
		MyInputs.ShortList)) {
		MySUI.returnError(CouldntAddItemErr);
		return false;
	}
	

	
	if( ! topMenu->addRequest(
		MyInputs.LongerList)) {
		MySUI.returnError(CouldntAddItemErr);
		return false;
	}
	

	
	if( ! topMenu->addRequest(
		MyInputs.RandomNumber)) {
		MySUI.returnError(CouldntAddItemErr);
		return false;
	}
	

	
	if( ! topMenu->addRequest(
		MyInputs.SomeText)) {
		MySUI.returnError(CouldntAddItemErr);
		return false;
	}
	

	
	if( ! topMenu->addRequest(
		MyInputs.TimeOfDay)) {
		MySUI.returnError(CouldntAddItemErr);
		return false;
	}
	

	
	if( ! topMenu->addRequest(
		MyInputs.ADateAndTime)) {
		MySUI.returnError(CouldntAddItemErr);
		return false;
	}
	

	
	if( ! topMenu->addRequest(
		MyInputs.EventField)) {
		MySUI.returnError(CouldntAddItemErr);
		return false;
	}
	

	// stuck();
	if( ! topMenu->addText(
		SUI_STR("Groups"),
		SUI_STR("A few group elements"))) {
		MySUI.returnError(CouldntAddItemErr);
		return false;
	}
	


    // Item GROUP 
	SerialUI::Menu::Menu * itmgrp5 = topMenu->addGroup(
		SUI_STR("Group A"),
		SUI_STR("a group of fields"));
	if (! itmgrp5 ) { 
		DIE_HORRIBLY(CouldntCreateMenuErr);
	}



    // Item GROUP 
	SerialUI::Menu::Menu * itmgrp6 = topMenu->addGroup(
		SUI_STR("Group B"),
		SUI_STR("another group"));
	if (! itmgrp6 ) { 
		DIE_HORRIBLY(CouldntCreateMenuErr);
	}



    // Item GROUP 
	SerialUI::Menu::Menu * itmgrp8 = topMenu->addGroup(
		SUI_STR("Group C"),
		SUI_STR("the important group"));
	if (! itmgrp8 ) { 
		DIE_HORRIBLY(CouldntCreateMenuErr);
	}



    // Item GROUP 
	SerialUI::Menu::Menu * itmgrp9 = topMenu->addGroup(
		SUI_STR("Another Group"),
		SUI_STR("a group"));
	if (! itmgrp9 ) { 
		DIE_HORRIBLY(CouldntCreateMenuErr);
	}


	
	if( ! topMenu->addText(
		SUI_STR("Views"),
		SUI_STR("some views"))) {
		MySUI.returnError(CouldntAddItemErr);
		return false;
	}
	

	
	if( ! topMenu->addView(
		MyViews.Current)) {
		MySUI.returnError(CouldntAddItemErr);
		return false;
	}
	

	
	if( ! topMenu->addView(
		MyViews.Graph)) {
		MySUI.returnError(CouldntAddItemErr);
		return false;
	}
	

	
	if( ! topMenu->addView(
		MyViews.Portions)) {
		MySUI.returnError(CouldntAddItemErr);
		return false;
	}
	

	
	if( ! topMenu->addView(
		MyViews.TheLog)) {
		MySUI.returnError(CouldntAddItemErr);
		return false;
	}
	



	/* *** Main Menu -> Menu 1 *** */



	/* *** Main Menu -> Menu 2 *** */



	/* *** Main Menu -> Menu 3 *** */



	/* *** Main Menu -> Group A *** */

	
	if( ! itmgrp5->addRequest(
		MyInputs.ASwitch)) {
		MySUI.returnError(CouldntAddItemErr);
		return false;
	}
	

	
	if( ! itmgrp5->addRequest(
		MyInputs.SomeNumber)) {
		MySUI.returnError(CouldntAddItemErr);
		return false;
	}
	

	
	if( ! itmgrp5->addRequest(
		MyInputs.Chars)) {
		MySUI.returnError(CouldntAddItemErr);
		return false;
	}
	

  // stuck();
	
	if( ! itmgrp5->addRequest(
		MyInputs.Ranger)) {
		MySUI.returnError(CouldntAddItemErr);
		return false;
	}
	



	/* *** Main Menu -> Group B *** */

	
	if( ! itmgrp6->addRequest(
		MyInputs.Num)) {
		MySUI.returnError(CouldntAddItemErr);
		return false;
	}
	

	
	if( ! itmgrp6->addRequest(
		MyInputs.ATimeOfDay)) {
		MySUI.returnError(CouldntAddItemErr);
		return false;
	}
	

	
	if( ! itmgrp6->addRequest(
		MyInputs.ASwitch2)) {
		MySUI.returnError(CouldntAddItemErr);
		return false;
	}
	

	
	if( ! itmgrp6->addCommand(
		SUI_STR("doit"),
		MainMenu::GroupB::doDoit,
		SUI_STR("a command"))) {
		MySUI.returnError(CouldntAddItemErr);
		return false;
	}
	



	/* *** Main Menu -> Group C *** */

	
	if( ! itmgrp8->addText(
		SUI_STR("Important stuff"),
		SUI_STR("this is the stuff"))) {
		MySUI.returnError(CouldntAddItemErr);
		return false;
	}
	

	
	if( ! itmgrp8->addRequest(
		MyInputs.Pi)) {
		MySUI.returnError(CouldntAddItemErr);
		return false;
	}
	

	
	if( ! itmgrp8->addRequest(
		MyInputs.Intensity)) {
		MySUI.returnError(CouldntAddItemErr);
		return false;
	}
	


	SerialUI::Menu::Menu * submen7 = itmgrp8->subMenu(
		SUI_STR("Subsub"),
		SUI_STR("a sub in a group"));
	if (! submen7 ) { 
		DIE_HORRIBLY(CouldntCreateMenuErr);
	}




	/* *** Main Menu -> Group C -> Subsub *** */

	
	if( ! submen7->addCommand(
		SUI_STR("Click me"),
		MainMenu::GroupC::Subsub::doClickMe,
		SUI_STR("or not"))) {
		MySUI.returnError(CouldntAddItemErr);
		return false;
	}
	



	/* *** Main Menu -> Another Group *** */

	
	if( ! itmgrp9->addRequest(
		MyInputs.Name)) {
		MySUI.returnError(CouldntAddItemErr);
		return false;
	}

  
  if( ! itmgrp9->addRequest(
    MyInputs.GroupCol)) {
    MySUI.returnError(CouldntAddItemErr);
    return false;
  }
	
	if( ! itmgrp9->addRequest(
		MyInputs.BigDate)) {
		MySUI.returnError(CouldntAddItemErr);
		return false;
	}
	

	
	if( ! itmgrp9->addRequest(
		MyInputs.Vet)) {
		MySUI.returnError(CouldntAddItemErr);
		return false;
	}

	
	return true;
	
}
